## gateway-firmware/main/Kconfig.projbuild
```kconfig
menu "Ultra-Low Power Mesh Configuration"

    choice
        bool "Mesh Topology"
        default MESH_TOPO_TREE
        help
            Mesh Network Topology.

        config MESH_TOPO_TREE
            bool "MESH_TOPO_TREE"
        config MESH_TOPO_CHAIN
            bool "MESH_TOPO_CHAIN"
    endchoice

    config MESH_TOPOLOGY
        int
        default 0 if MESH_TOPO_TREE
        default 1 if MESH_TOPO_CHAIN
        help
            Mesh Network Topology.

    config MESH_ENABLE_PS
        bool "Enable mesh PS (power save) function"
        default y
        help
            Enable/Disable Power Save function.

    choice
        bool "Mesh PS device duty cycle type"
        depends on MESH_ENABLE_PS
        default MESH_PS_DEV_DUTY_TYPE_REQUEST
        help
            Mesh PS device duty cycle type.

        config MESH_PS_DEV_DUTY_TYPE_REQUEST
            bool "MESH_PS_DEV_DUTY_TYPE_REQUEST"
        config MESH_PS_DEV_DUTY_TYPE_DEMAND
            bool "MESH_PS_DEV_DUTY_TYPE_DEMAND"
    endchoice

    config MESH_PS_DEV_DUTY_TYPE
        int
        depends on MESH_ENABLE_PS
        default 1 if MESH_PS_DEV_DUTY_TYPE_REQUEST
        default 4 if MESH_PS_DEV_DUTY_TYPE_DEMAND
        help
            Mesh PS device duty cycle type.

    config MESH_PS_DEV_DUTY
        int "Mesh PS device duty cycle"
        depends on MESH_ENABLE_PS
        range 1 100
        default 10
        help
            Mesh PS device duty cycle.

    config MESH_PS_NWK_DUTY
        int "Mesh PS network duty cycle"
        depends on MESH_ENABLE_PS
        range 1 100
        default 10
        help
            Mesh PS network duty cycle.

    config MESH_PS_NWK_DUTY_DURATION
        int "Mesh PS network duty cycle duration (unit: minutes)"
        depends on MESH_ENABLE_PS
        range -1 100
        default -1
        help
            Mesh PS network duty cycle duration.

    choice
        bool "Mesh PS network duty cycle rule"
        depends on MESH_ENABLE_PS
        default MESH_PS_NETWORK_DUTY_APPLIED_ENTIRE
        help
            Mesh PS network duty cycle rule.

        config MESH_PS_NETWORK_DUTY_APPLIED_ENTIRE
            bool "MESH_PS_NETWORK_DUTY_APPLIED_ENTIRE"
        config MESH_PS_NETWORK_DUTY_APPLIED_UPLINK
            bool "MESH_PS_NETWORK_DUTY_APPLIED_UPLINK"
    endchoice

    config MESH_PS_NWK_DUTY_RULE
        int
        depends on MESH_ENABLE_PS
        default 0 if MESH_PS_NETWORK_DUTY_APPLIED_ENTIRE
        default 1 if MESH_PS_NETWORK_DUTY_APPLIED_UPLINK
        help
            Mesh PS network duty cycle rule.

    config MESH_MAX_LAYER
        int "Mesh Max Layer"
        range 1 25 if MESH_TOPO_TREE
        range 1 1000 if MESH_TOPO_CHAIN
        default 8
        help
            Max layer allowed in mesh network.

    config MESH_CHANNEL
        int "channel"
        range 0 14
        default 6
        help
            mesh network channel (6 = matches router channel).

    config MESH_ROUTER_SSID
        string "Router SSID"
        default "VM4248447"
        help
            Router SSID.

    config MESH_ROUTER_PASSWD
        string "Router password"
        default "Rt5dvpsk6mpd"
        help
            Router password.

    choice
        bool "Mesh AP Authentication Mode"
        default WIFI_AUTH_WPA2_PSK
        help
            Authentication mode.

        config WIFI_AUTH_OPEN
            bool "WIFI_AUTH_OPEN"
        config WIFI_AUTH_WPA_PSK
            bool "WIFI_AUTH_WPA_PSK"
        config WIFI_AUTH_WPA2_PSK
            bool "WIFI_AUTH_WPA2_PSK"
        config WIFI_AUTH_WPA_WPA2_PSK
            bool "WIFI_AUTH_WPA_WPA2_PSK"
    endchoice

    config MESH_AP_AUTHMODE
        int
        default 0 if WIFI_AUTH_OPEN
        default 2 if WIFI_AUTH_WPA_PSK
        default 3 if WIFI_AUTH_WPA2_PSK
        default 4 if WIFI_AUTH_WPA_WPA2_PSK
        help
            Mesh AP authentication mode.

    config MESH_AP_PASSWD
        string "Mesh AP Password"
        default "MAP_PASSWD"
        help
            Mesh AP password.

    config MESH_AP_CONNECTIONS
        int "Mesh AP max connections"
        range 1 10
        default 1
        help
            Max connections of mesh AP (1 = forces gateway to accept only 1 child, creating multi-level topology)

    config MESH_NON_MESH_AP_CONNECTIONS
        int "Mesh Non Mesh AP Connections"
        range 0 9
        default 0
        help
            The number of non-mesh stations allowed to connect in.

    config MESH_ROUTE_TABLE_SIZE
        int "Mesh Routing Table Size"
        range 1 300
        default 50
        help
            The number of devices over the network(max: 300).

endmenu

menu "SIM800L Configuration"

    config SIM800L_ENABLE
        bool "Enable SIM800L GSM/GPRS Module"
        default n
        help
            Enable SIM800L GSM/GPRS module for cellular connectivity.

    config SIM800L_UART_PORT
        int "UART Port Number"
        depends on SIM800L_ENABLE
        range 0 2
        default 2
        help
            UART port number for SIM800L communication (usually UART2).

    config SIM800L_TX_PIN
        int "TX Pin"
        depends on SIM800L_ENABLE
        range 0 48
        default 17
        help
            GPIO pin number for UART TX (ESP32-S3 -> SIM800L RX).
            Safe pins for ESP32-S3: GPIO17, GPIO16, GPIO15, GPIO7, GPIO6.

    config SIM800L_RX_PIN
        int "RX Pin"
        depends on SIM800L_ENABLE
        range 0 48
        default 18
        help
            GPIO pin number for UART RX (SIM800L TX -> ESP32-S3).
            Safe pins for ESP32-S3: GPIO18, GPIO8, GPIO3, GPIO9, GPIO10.

    config SIM800L_BAUD_RATE
        int "Baud Rate"
        depends on SIM800L_ENABLE
        default 9600
        help
            Communication baud rate for SIM800L (typically 9600 or 115200).

    config SIM800L_APN
        string "APN (Access Point Name)"
        depends on SIM800L_ENABLE
        default "everywhere"
        help
            APN for GPRS connection. For EE UK: "everywhere"

    config SIM800L_APN_USERNAME
        string "APN Username"
        depends on SIM800L_ENABLE
        default "eesecure"
        help
            APN username. For EE UK: "eesecure"

    config SIM800L_APN_PASSWORD
        string "APN Password"
        depends on SIM800L_ENABLE
        default "secure"
        help
            APN password. For EE UK: "secure"

endmenu 
```
